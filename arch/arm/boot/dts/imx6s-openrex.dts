// SPDX-License-Identifier: GPL-2.0+
//
// Copyright 2012 Freescale Semiconductor, Inc.
// Copyright 2011 Linaro Ltd.

/dts-v1/;

#include "imx6dl.dtsi"
#include "imx6qdl-openrex.dtsi"

/ {
	model = "Fedevel i.MX6 Solo OpenRex";
	compatible = "fsl,imx6s-openrex", "fsl,imx6dl";

        memory@10000000 {
		device_type = "memory";
		reg = <0x10000000 0x20000000>;
	};
};



&ipu1_csi1_from_mipi_vc1 {
	clock-lanes = <0>;
	data-lanes = <1 2>;
};
